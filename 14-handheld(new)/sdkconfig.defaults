## 14-handheld(new)/sdkconfig.defaults
```kconfig
# LCKFB ESP32-S3 Handheld Device - Default Config
# Adapted for ESP-IDF v5.5.1
#
# Chip & Flash
CONFIG_IDF_TARGET="esp32s3"
CONFIG_ESPTOOLPY_FLASHSIZE_16MB=y

# Partition Table
CONFIG_PARTITION_TABLE_CUSTOM=y

# Bluetooth (BLE HID Device)
CONFIG_BT_ENABLED=y
CONFIG_BT_BLE_42_FEATURES_SUPPORTED=y

# PSRAM (Octal 80MHz, 8MB)
CONFIG_SPIRAM=y
CONFIG_SPIRAM_MODE_OCT=y
CONFIG_SPIRAM_SPEED_80M=y
CONFIG_SPIRAM_MALLOC_ALWAYSINTERNAL=2048
CONFIG_SPIRAM_TRY_ALLOCATE_WIFI_LWIP=y

# CPU Frequency
CONFIG_ESP_DEFAULT_CPU_FREQ_MHZ_240=y

# Cache
CONFIG_ESP32S3_INSTRUCTION_CACHE_32KB=y
CONFIG_ESP32S3_DATA_CACHE_64KB=y
CONFIG_ESP32S3_DATA_CACHE_LINE_64B=y

# WiFi Buffers
CONFIG_ESP_WIFI_STATIC_RX_BUFFER_NUM=10
CONFIG_ESP_WIFI_RX_BA_WIN=6

# FAT Filesystem (Chinese filename support)
CONFIG_FATFS_LFN_HEAP=y
CONFIG_FATFS_CODEPAGE_936=y
CONFIG_FATFS_API_ENCODING_UTF_8=y
CONFIG_FATFS_VFS_FSTAT_BLKSIZE=4096

# LWIP
CONFIG_LWIP_TCP_OOSEQ_MAX_PBUFS=4

# OpenThread
CONFIG_OPENTHREAD_RX_ON_WHEN_IDLE=y

# SPIFFS
CONFIG_SPIFFS_OBJ_NAME_LEN=128

# LVGL
CONFIG_LV_COLOR_16_SWAP=y
CONFIG_LV_MEM_CUSTOM=y
CONFIG_LV_FONT_MONTSERRAT_20=y
CONFIG_LV_FONT_MONTSERRAT_24=y
CONFIG_LV_FONT_FMT_TXT_LARGE=y
CONFIG_LV_USE_PNG=y
CONFIG_LV_USE_GIF=y

# I2C - Skip legacy conflict check (esp_lcd always compiles both v1/v2 I2C drivers)
CONFIG_I2C_SKIP_LEGACY_CONFLICT_CHECK=y
```

## esp-claw/application/basic_demo/boards/esp32_s3_szp/sdkconfig.defaults.board
```kconfig
# SZP Board: ESP32-S3-WROOM-1-N16R8

# CPU frequency
CONFIG_ESP_DEFAULT_CPU_FREQ_MHZ_240=y

# Flash: 16MB QIO @ 80MHz
CONFIG_ESPTOOLPY_FLASHMODE_QIO=y
CONFIG_ESPTOOLPY_FLASHFREQ_80M=y
CONFIG_ESPTOOLPY_FLASHSIZE_16MB=y

# PSRAM: 8MB Octal @ 80MHz
CONFIG_SPIRAM=y
CONFIG_SPIRAM_MODE_OCT=y
CONFIG_SPIRAM_SPEED_80M=y
CONFIG_SPIRAM_XIP_FROM_PSRAM=n

# Skip I2C legacy conflict check (esp_lcd compiles both v1/v2 I2C drivers)
CONFIG_I2C_SKIP_LEGACY_CONFLICT_CHECK=y

# Octal PSRAM shares the SPI bus with flash. When flash cache is disabled for
# NVS/FAT/partition operations, PSRAM becomes inaccessible. Task stacks in PSRAM
# would trigger an assert. Disable external memory for task stacks so that
# CLAW_TASK_STACK_PREFER_PSRAM falls back to internal RAM for all claw tasks.
CONFIG_FREERTOS_TASK_CREATE_ALLOW_EXT_MEM=n
```
